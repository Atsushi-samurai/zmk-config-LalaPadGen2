## dts/bindings/input_processors/zmk,input-processor-pinch-zoom-keys.yaml
```yaml
description: Convert IQS9151 pinch wheel events to zoom behavior taps

compatible: "zmk,input-processor-pinch-zoom-keys"

include: ip_zero_param.yaml

properties:
  pinch-code:
      type: int
          default: 279
            min-interval-ms:
                type: int
                    default: 150
                      bindings:
                          type: phandle-array
                              required: true
                              
```
